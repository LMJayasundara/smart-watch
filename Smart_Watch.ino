// Adding Libraries
#include <Wire.h>
#include <SPI.h>
#include <SimpleKalmanFilter.h>
#include <Adafruit_GFX.h>
#include <Adafruit_SSD1306.h>
#include <MPU6050.h>

// Display Properties
#define SCREEN_WIDTH 128
#define SCREEN_HEIGHT 64
#define OLED_RESET LED_BUILTIN
Adafruit_SSD1306 display(SCREEN_WIDTH, SCREEN_HEIGHT, &Wire, OLED_RESET);
long refresh_time = 0;

// Intialized Kalman Filter
SimpleKalmanFilter kalmanFilter(2.5, 2.5, 0.1);

// MPU6050 Properties
MPU6050 mpu;
const int MPU = 0x68; // MPU6050 I2C address
float AccX, AccY, AccZ, Temp = 0.0;
float AccFX, AccFY, AccFZ = 0.0;
float AccErrorX, AccErrorY, AccErrorZ = 0.0;
int c = 0;

// Steps Detector Properties
int stepThreshold = 1.8;
boolean isPassedThreshold = false;
long passedThresholdTimestamp = 0;
int steps = 0;
boolean walking = false;

// Display Values Properties
#define interval1 1000
#define interval2 2000
#define interval3 1000
#define interval4 2000
unsigned long time1 = 0;
unsigned long time2 = 0;
unsigned long time3 = 0;
unsigned long time4 = 0;
unsigned long previousMillis = 0; 

unsigned long curtime = 0;
unsigned long prvtime = 0;
unsigned long delaytime = 30;
int count = 0;

// Bitmaps
const unsigned char onScreenBitmap [] PROGMEM = {
  0x00, 0x00, 0x00, 0x3f, 0xfc, 0x00, 0x00, 0x00, 0x00, 0x00, 0x03, 0xff, 0xff, 0xc0, 0x00, 0x00, 
  0x00, 0x00, 0x0f, 0xc0, 0x03, 0xf0, 0x00, 0x00, 0x00, 0x00, 0x7c, 0x00, 0x00, 0x3e, 0x00, 0x00, 
  0x00, 0x00, 0xf0, 0x1f, 0xf8, 0x0f, 0x00, 0x00, 0x00, 0x03, 0xc1, 0xff, 0xff, 0x83, 0xc0, 0x00, 
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  0x00, 0x00, 0x03, 0xff, 0xff, 0xc0, 0x00, 0x00, 0x00, 0x00, 0x00, 0x3f, 0xfc, 0x00, 0x00, 0x00
};

const unsigned char tempBitmap [] PROGMEM = {
  0x00, 0x00, 0x30, 0x00, 0x78, 0x1e, 0xcc, 0x7f, 0x8c, 0xf3, 0xcd, 0xc0, 0x79, 0xc0, 0x01, 0x80, 
  0x03, 0x80, 0x01, 0x80, 0x01, 0xc0, 0x01, 0xe0, 0x00, 0xff, 0x00, 0x7f, 0x00, 0x1c, 0x00, 0x00
};

const unsigned char stepsBitmap [] PROGMEM = {
  0x00, 0x00, 0x00, 0x18, 0x00, 0x3c, 0x00, 0x3e, 0x1e, 0x7e, 0x1f, 0x7e, 0x3f, 0x7e, 0x3f, 0x7c, 
  0x3e, 0x7c, 0x3c, 0x48, 0x3c, 0x78, 0x08, 0x70, 0x78, 0x70, 0x78, 0x00, 0x38, 0x00, 0x00, 0x00
};

const unsigned char walkBitmap [] PROGMEM = {
  0x00, 0x00, 0x00, 0x00, 0x00, 0x00, 0x00, 0x00, 0x00, 0x00, 0x00, 0x00, 0x00, 0x00, 0x00, 0x00, 
  0x00, 0x00, 0x00, 0x00, 0x00, 0x00, 0x00, 0x00, 0x00, 0x00, 0x00, 0x00, 0x00, 0x00, 0x00, 0x00, 
  0x00, 0x00, 0x00, 0x00, 0x00, 0x7e, 0x00, 0x00, 0x00, 0x00, 0x00, 0x00, 0x00, 0xff, 0x00, 0x00, 
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  0x00, 0x00, 0x00, 0x00, 0x00, 0x00, 0x00, 0x00, 0x00, 0x00, 0x00, 0x00, 0x00, 0x00, 0x00, 0x00
};

const unsigned char alarmBitmap [] PROGMEM = {
  0x00, 0x00, 0x00, 0x1f, 0xf8, 0x00, 0x00, 0x00, 0x00, 0x00, 0x00, 0x3f, 0xfc, 0x00, 0x00, 0x00, 
  0x00, 0x00, 0x00, 0x3f, 0xfc, 0x00, 0x00, 0x00, 0x00, 0x00, 0x00, 0x3f, 0xfc, 0x00, 0x00, 0x00, 
  0x00, 0x00, 0x00, 0x3f, 0xfc, 0x00, 0x00, 0x00, 0x00, 0x00, 0x00, 0x3f, 0xfc, 0x00, 0x00, 0x00, 
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  0x00, 0x00, 0x01, 0xff, 0xff, 0x80, 0x00, 0x00, 0x00, 0x00, 0x00, 0x1f, 0xf8, 0x00, 0x00, 0x00
};

void setup() {
  Serial.begin(19200);               // Make sure Serial Monitor or Serial Plotter set to this Value
  
  if(!display.begin(SSD1306_SWITCHCAPVCC, 0x3C)) {
    Serial.println(F("SSD1306 allocation failed"));
  }

  if(!mpu.begin(MPU6050_SCALE_2000DPS, MPU6050_RANGE_2G))
  {
    Serial.println("Could not find a MPU6050 sensor");
  }
  
  Wire.begin();                      // Initialize comunication
  Wire.beginTransmission(MPU);       // Start communication with MPU6050 // MPU=0x68
  Wire.write(0x6B);                  // Talk to the register 6B
  Wire.write(0x00);                  // Make reset - place a 0 into the 6B register
  Wire.endTransmission(true);        // end the transmission

  // Call this function if you need to get the IMU error values for your module
  calculate_IMU_error();
  delay(50);

  display.clearDisplay();
  display.drawBitmap(32, 0, onScreenBitmap, 64, 64, WHITE); 
  display.display();
  delay(3000);

  display.clearDisplay();
  display.setTextSize(2);
  display.setTextColor(WHITE);
  display.setCursor(50, 25);
  display.println("BE");
  display.display();
  delay(1000);

  display.clearDisplay();
  display.setTextSize(2);
  display.setTextColor(WHITE);
  display.setCursor(35, 25);
  display.println("SMART");
  display.display();
  delay(1500);
  
  /*
  // Configure Accelerometer Sensitivity - Full Scale Range (default +/- 2g)
  Wire.beginTransmission(MPU);
  Wire.write(0x1C);                  //Talk to the ACCEL_CONFIG register (1C hex)
  Wire.write(0x10);                  //Set the register bits as 00010000 (+/- 8g full scale range)
  Wire.endTransmission(true);
  // Configure Gyro Sensitivity - Full Scale Range (default +/- 250deg/s)
  Wire.beginTransmission(MPU);
  Wire.write(0x1B);                   // Talk to the GYRO_CONFIG register (1B hex)
  Wire.write(0x10);                   // Set the register bits as 00010000 (1000deg/s full scale)
  Wire.endTransmission(true);
  delay(20);
  */
}

void loop() {
  //Read acceleromter data
  Wire.beginTransmission(MPU);
  Wire.write(0x3B); // Start with register 0x3B (ACCEL_XOUT_H)
  Wire.endTransmission(false);
  Wire.requestFrom(MPU, 14, true); // Read 6 registers total, each axis value is stored in 2 registers
  //For a range of +-2g, we need to divide the raw values by 16384, according to the datasheet
  AccX = (Wire.read() << 8 | Wire.read()) / 16384.0; // X-axis value
  AccY = (Wire.read() << 8 | Wire.read()) / 16384.0; // Y-axis value
  AccZ = (Wire.read() << 8 | Wire.read()) / 16384.0; // Z-axis value
  Temp = mpu.readTemperature();

  // AccFX = AccX - AccErrorX; // AccErrorX See the calculate_IMU_error()custom function for more details
  // AccFY = AccY - AccErrorY; // AccErrorY See the calculate_IMU_error()custom function for more details
  AccFZ = AccZ - AccErrorZ; // AccErrorZ See the calculate_IMU_error()custom function for more details


  float filtered_value = kalmanFilter.updateEstimate(AccFZ); // Used kalman filter for filtering input data (Redused input data noices)
  
  //  Serial.print(" X: ");
  //  Serial.println(AccFX);
  //  Serial.print(" Y: ");
  //  Serial.println(AccFY);
  //  Serial.print(" Z: ");
  //  Serial.println(AccFZ);
  //  Serial.print(" Temp: ");
  //  Serial.println(Temp);

  Serial.print("Filtered: ");
  Serial.println(filtered_value);

  /////////////////////////////////////////////////////////////////////////////////////////////////////////////////
  // Steps detector

  if(filtered_value > stepThreshold) {
    if(! isPassedThreshold) {
      isPassedThreshold = true;
      passedThresholdTimestamp = millis();
      steps += 1;
      walking = true;
      // Serial.println("Walking");
    }
  }
  
  else{
    if(isPassedThreshold && millis() - passedThresholdTimestamp < 2000){
      isPassedThreshold = false;
    }
    else if (! isPassedThreshold && millis() - passedThresholdTimestamp > 1000){
      isPassedThreshold = false;
       walking = false;
       // Serial.println("Not Walking");
    }
  }
  
  //  Serial.print("Steps :");
  //  Serial.println(steps);

  /////////////////////////////////////////////////////////////////////////////////////////////////////////////////

  if(walking){
    // Serial.println("walking");
    count = 0;
    if(millis() - previousMillis > 1000){
      previousMillis = millis(); 
      display.clearDisplay();
      display.drawBitmap(32, 0, walkBitmap, 64, 64, WHITE); 
      display.display();
    }
  }
  else{
    while(!walking){
      walking = true;
      curtime = millis();
      if(curtime - prvtime > 1000){
        prvtime = curtime;
        count ++;
      }
      if( count <= delaytime){
        // Serial.println("you can Rest");
        if(millis() >= time1 + interval1){
          time1 += interval1;
          display.clearDisplay();
          display.setTextSize(2);
          display.setTextColor(WHITE);
          display.setCursor(0, 30);
          display.drawBitmap(56, 0, tempBitmap, 16, 16, WHITE); 
          display.print("Temp: ");
          display.println(Temp, 1);
          display.display();
        }
       
        if(millis() >= time2 + interval2){
          time2 += interval2;
          display.clearDisplay();
          display.setTextSize(2);
          display.setTextColor(WHITE);
          display.setCursor(10, 30);
          display.drawBitmap(56, 0, stepsBitmap, 16, 16, WHITE); 
          display.print("Steps: ");
          display.println(steps);
          display.display();
        }
      }
      else{
        // Serial.println("you have to walking");
        if(millis() >= time1 + interval1){
          time1 += interval1;
          display.clearDisplay();
          display.drawBitmap(32, 0, alarmBitmap, 64, 64, WHITE); 
          display.display();
        }
       
        if(millis() >= time2 + interval2){
          time2 += interval2;
          display.clearDisplay();
          display.setTextSize(2);
          display.setTextColor(WHITE);
          display.setCursor(20, 30);
          display.print("Times Up");
          display.display();
        }
      }
    }
  }

} // end loop

void calculate_IMU_error() {
  // We can call this funtion in the setup section to calculate the accelerometer data error. From here we will get the error values used in the above equations printed on the Serial Monitor.
  // Note that we should place the IMU flat in order to get the proper values, so that we then can the correct values
  // Read accelerometer values 200 times
  while (c < 200) {
    Wire.beginTransmission(MPU);
    Wire.write(0x3B);
    Wire.endTransmission(false);
    Wire.requestFrom(MPU, 6, true);
    AccX = (Wire.read() << 8 | Wire.read()) / 16384.0 ;
    AccY = (Wire.read() << 8 | Wire.read()) / 16384.0 ;
    AccZ = (Wire.read() << 8 | Wire.read()) / 16384.0 ;
    // Sum all readings
    // AccErrorX = AccErrorX + AccX;
    // AccErrorY = AccErrorY + AccY;
    AccErrorZ = AccErrorZ + AccZ;
    c++;
  }
  //Divide the sum by 500 to get the error value
  // AccErrorX = AccErrorX / 200;
  // AccErrorY = AccErrorY / 200;
  AccErrorZ = AccErrorZ / 200;
  c = 0;
  
  //  Serial.print("AccErrorX: ");
  //  Serial.println(AccErrorX);
  //  Serial.print("AccErrorY: ");
  //  Serial.println(AccErrorY);
  //  Serial.print("AccErrorZ: ");
  //  Serial.println(AccErrorZ);
}
